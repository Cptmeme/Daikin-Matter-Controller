## Faikout_Matter/sdkconfig.defaults.matter-n8
```kconfig
# ESP32-S3-MINI with 8 MB flash and no PSRAM (upstream's -S3-MINI-N8)
CONFIG_ESPTOOLPY_FLASHSIZE_4MB=n
CONFIG_ESPTOOLPY_FLASHSIZE_8MB=y
CONFIG_ESPTOOLPY_FLASHSIZE="8MB"
CONFIG_PARTITION_TABLE_CUSTOM=y
CONFIG_PARTITION_TABLE_CUSTOM_FILENAME="components/ESP32-RevK/partitions_8m.csv"
CONFIG_PARTITION_TABLE_FILENAME="components/ESP32-RevK/partitions_8m.csv"
CONFIG_SPIRAM=n
CONFIG_ESP32S3_SPIRAM_SUPPORT=n
CONFIG_BT_NIMBLE_MEM_ALLOC_MODE_EXTERNAL=n
CONFIG_BT_NIMBLE_MEM_ALLOC_MODE_DEFAULT=y
CONFIG_REVK_ETHERNET=n
CONFIG_REVK_ETH_KSZ8851SNL=n
CONFIG_REVK_MINI=y
CONFIG_REVK_BUILD_SUFFIX="-S3-MINI-N8-MT"
```

## Thermostat_Daikin/sdkconfig.defaults.thread
```kconfig
# Matter over Thread, for chips with a Thread radio. Used by the thread-c5 image. The ESP32-C6 gets
# the same settings from sdkconfig.defaults.esp32c6.
CONFIG_LIBSODIUM_USE_MBEDTLS_SHA=y

CONFIG_BT_NIMBLE_EXT_ADV=n
CONFIG_BT_NIMBLE_HCI_EVT_BUF_SIZE=70
CONFIG_USE_BLE_ONLY_FOR_COMMISSIONING=n

CONFIG_OPENTHREAD_ENABLED=y
CONFIG_OPENTHREAD_SRP_CLIENT=y
CONFIG_OPENTHREAD_DNS_CLIENT=y
CONFIG_OPENTHREAD_LOG_LEVEL_DYNAMIC=n
CONFIG_OPENTHREAD_LOG_LEVEL_NOTE=y
CONFIG_OPENTHREAD_CLI=n

CONFIG_LWIP_IPV6_AUTOCONFIG=n
CONFIG_LWIP_IPV6_NUM_ADDRESSES=8
CONFIG_LWIP_MULTICAST_PING=y

CONFIG_USE_MINIMAL_MDNS=n
CONFIG_ENABLE_EXTENDED_DISCOVERY=y

CONFIG_ENABLE_WIFI_STATION=n
CONFIG_PARTITION_TABLE_CUSTOM_FILENAME="partitions.csv"
```
